## Kconfig
```kconfig
config ZMK_BEHAVIOR_BUZZER
	bool "Buzzer behavior"
	default y
	depends on DT_HAS_ZMK_BEHAVIOR_BUZZER_ENABLED
	select PWM
if ZMK_BEHAVIOR_BUZZER

config ZMK_BEHAVIOR_BUZZER_INIT_PRIORITY
	int "Buzzer behavior initialization priority"
	default 90
	range 0 99

endif
```

## boards/arm/pocketdeck/pocketdeck_defconfig
```kconfig
CONFIG_ZMK_BLE=y
CONFIG_ZMK_USB=y
CONFIG_BT_LL_SW_SPLIT=y
CONFIG_CLOCK_CONTROL_NRF=y
CONFIG_CLOCK_CONTROL_NRF_K32SRC_RC=y
CONFIG_MPU_ALLOW_FLASH_WRITE=y
CONFIG_NVS=y
CONFIG_SETTINGS=y
CONFIG_SETTINGS_NVS=y
CONFIG_FLASH=y
CONFIG_FLASH_PAGE_LAYOUT=y
CONFIG_FLASH_MAP=y
```

## dts/bindings/behavior/zmk,behavior-buzzer.yaml
```yaml
description: Buzzer behavior driven by a PWM channel

compatible: "zmk,behavior-buzzer"

include: one_param.yaml

properties:
  pwms:
    type: phandle-array
    required: true
  duration-ms:
    type: int
    default: 40
```
